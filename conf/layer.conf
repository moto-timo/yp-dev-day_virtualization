## conf/layer.conf
```bitbake
# We have a conf and classes directory, append to BBPATH
BBPATH .= ":${LAYERDIR}"

# We have a recipes directory, add to BBFILES
BBFILES += "${LAYERDIR}/recipes*/*/*.bb ${LAYERDIR}/recipes*/*/*.bbappend"

BBFILE_COLLECTIONS += "ypdd-virtualization-layer"
BBFILE_PATTERN_ypdd-virtualization-layer := "^${LAYERDIR}/"
BBFILE_PRIORITY_ypdd-virtualization-layer = "8"

# This should only be incremented on significant changes that will
# cause compatibility issues with other layers
LAYERVERSION_ypdd-virtualization-layer = "1"
LAYERSERIES_COMPAT_ypdd-virtualization-layer = "honister"
LAYERDEPENDS_ypdd-virtualization-layer = " \
    core \
    intel \
    openembedded-layer \
    meta-acrn \    
    meta-python \    
    filesystems-layer \
    networking-layer \    
    virtualization-layer \    
    cloud-services-layer \
    security \
    perl-layer \
"

BBFILES_DYNAMIC += " \
    virtualization-layer:${LAYERDIR}/dynamic-layers/virtualization-layer/*/*/*.bb \
    virtualization-layer:${LAYERDIR}/dynamic-layers/virtualization-layer/*/*/*.bbappend \
"
```
